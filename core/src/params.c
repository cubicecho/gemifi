/*
 * params.c: param validation, defaults and the schema blob (sysex.md 4.4).
 *
 * The schema is never held in RAM (4 KB total): it is generated byte by
 * byte from the param table, and a window [offset, offset + max) is copied
 * out. A read walks the table only up to the end of its window, and the
 * size is worked out once (the table doesn't change after
 * gm_settings_init). A read also remembers where the last param it
 * started begins, so the next window (a download asks for them in order)
 * starts there instead of at byte 0: each window costs about its own
 * length, not the whole schema up to it.
 *
 * SPDX-License-Identifier: MIT
 */
#include "params.h"
#include "gsx.h"

uint32_t params_gen;

int32_t params_default_at(const param_def_t *p, uint32_t i)
{
    return p->defs ? p->defs[i] : p->def;
}

void params_defaults(void)
{
    params_gen++;
    for (uint32_t k = 0; k < app_params.param_count; k++) {
        const param_def_t *p = &app_params.params[k];
        for (uint32_t i = 0; i < p->count; i++)
            p->values[i] = params_default_at(p, i);
    }
}

const param_def_t *params_find(uint16_t id)
{
    for (uint32_t k = 0; k < app_params.param_count; k++)
        if (app_params.params[k].id == id)
            return &app_params.params[k];
    return 0;
}

int params_get(uint16_t id, uint16_t index, int32_t *out)
{
    const param_def_t *p = params_find(id);
    if (!p || index >= p->count)
        return GSX_BAD_PARAM;
    *out = p->values[index];
    return GSX_OK;
}

int params_value_ok(const param_def_t *p, int32_t value)
{
    if (value < p->min || value > p->max)
        return 0;
    /* An enum option without a label is one this firmware left out
     * (settings.c: a button action or mode the device doesn't have). */
    return p->type != PT_ENUM || !p->options || p->options[value - p->min];
}

int params_set(uint16_t id, uint16_t index, int32_t value, int from_host)
{
    const param_def_t *p = params_find(id);
    if (!p || index >= p->count || (from_host && (p->flags & PF_READ_ONLY)))
        return GSX_BAD_PARAM;
    if (!params_value_ok(p, value))
        return GSX_BAD_VALUE;
    p->values[index] = value;
    params_gen++;
    return GSX_OK;
}

/* ---- schema writer ---------------------------------------------------- */

typedef struct {
    uint32_t pos;        /* bytes generated so far */
    uint32_t offset;     /* window start           */
    uint8_t *dst;
    uint32_t max;
    uint32_t n;          /* bytes copied           */
    uint32_t end;        /* offset + max: the walk can stop here */
} sw_t;

static void sw_byte(sw_t *w, uint32_t b)
{
    if (w->pos >= w->offset && w->n < w->max)
        w->dst[w->n++] = (uint8_t)b;
    w->pos++;
}

static void sw_le(sw_t *w, uint32_t v, uint32_t bytes)
{
    while (bytes--) {
        sw_byte(w, v & 0xFFu);
        v >>= 8;
    }
}

static void sw_str(sw_t *w, const char *s)
{
    uint32_t len = 0;
    while (s && s[len] && len < 63)
        len++;
    sw_byte(w, len);
    for (uint32_t i = 0; i < len; i++)
        sw_byte(w, (uint8_t)s[i] & 0x7Fu);
}

/* Resume point: param resume_k starts at byte resume_pos (0 = none yet;
 * the header comes first, so no param starts at 0). */
static uint32_t resume_k, resume_pos;

/* Generates from param k0, which starts at w->pos; k0 = 0 with w->pos = 0
 * is the whole blob, header first. */
static void schema_walk(sw_t *w, uint32_t k0)
{
    const param_table_t *t = &app_params;
    if (!k0 && !w->pos) {
        sw_byte(w, PARAMS_SCHEMA_VERSION);
        sw_byte(w, t->group_count);
        sw_le(w, t->param_count, 2);
        for (uint32_t g = 0; g < t->group_count; g++)
            sw_str(w, t->groups[g]);
    }
    for (uint32_t k = k0; k < t->param_count; k++) {
        if (w->pos <= w->end) {     /* the last param starting by the end */
            resume_k = k;
            resume_pos = w->pos;
        }
        if (w->pos >= w->end)
            return;                 /* past the window: the rest isn't copied */
        const param_def_t *p = &t->params[k];
        uint32_t flags = p->flags & (PF_READ_ONLY | PF_VOLATILE | PF_PRESET);
        if (p->defs)
            flags |= PF_PER_INDEX_DEFAULT;
        if (p->index_labels)
            flags |= PF_INDEX_LABELS;
        if (p->unit)
            flags |= PF_HAS_UNIT;
        sw_le(w, p->id, 2);
        sw_byte(w, p->type);
        sw_byte(w, p->group);
        sw_le(w, p->count, 2);
        sw_byte(w, flags);
        sw_le(w, (uint32_t)p->min, 4);
        sw_le(w, (uint32_t)p->max, 4);
        uint32_t ndef = p->defs ? p->count : 1u;
        for (uint32_t i = 0; i < ndef; i++)
            sw_le(w, (uint32_t)params_default_at(p, i), 4);
        sw_str(w, p->name);
        sw_str(w, p->label);
        if (p->unit)
            sw_str(w, p->unit);
        if (p->index_labels)
            for (uint32_t i = 0; i < p->count; i++)
                sw_str(w, p->index_labels[i]);
        if (p->type == PT_ENUM) {
            sw_byte(w, p->option_count);
            for (uint32_t i = 0; i < p->option_count; i++)
                sw_str(w, p->options[i]);
        }
    }
}

static uint32_t schema_bytes;     /* 0 = not worked out yet */

void params_schema_measure(void)
{
    sw_t w = { 0, 0, 0, 0, 0, 0xFFFFFFFFu };
    schema_walk(&w, 0);
    schema_bytes = w.pos;
    resume_k = resume_pos = 0;      /* the table may have changed */
}

uint32_t params_schema_size(void)
{
    if (!schema_bytes)
        params_schema_measure();
    return schema_bytes;
}

uint32_t params_schema_read(uint32_t offset, uint8_t *dst, uint32_t max)
{
    uint32_t end = offset + max;
    sw_t w = { 0, offset, dst, max, 0, end < offset ? 0xFFFFFFFFu : end };
    uint32_t k0 = 0;
    if (resume_pos && offset >= resume_pos) {
        k0 = resume_k;              /* at or after the last window */
        w.pos = resume_pos;
    }
    schema_walk(&w, k0);
    return w.n;
}
